## main/Kconfig.projbuild
```kconfig
menu "Modem / Quectel EC200U-CN UART Configuration"

    config MODEM_APN
        string "SIM APN"
        default "airtelgprs.com"
        help
            Carrier APN passed to esp_modem's DCE config.
            Examples: airtelgprs.com, jionet, internet.

    config MODEM_UART_PORT_NUM
        int "UART port number"
        default 1
        range 0 2
        help
            ESP32-S3 UART controller to use for the modem link. Avoid
            UART0 if it's your console/flashing port.

    config MODEM_UART_TX_PIN
        int "TXD GPIO (ESP32-S3 -> module Rx)"
        default 17
        range 0 48
        help
            ESP32-S3 GPIO wired to the module's UART Rx pin.

    config MODEM_UART_RX_PIN
        int "RXD GPIO (ESP32-S3 <- module Tx)"
        default 18
        range 0 48
        help
            ESP32-S3 GPIO wired to the module's UART Tx pin.

    config MODEM_UART_RTS_PIN
        int "RTS GPIO (unused on Vanix TracX-1b)"
        default 8
        range -1 48
        help
            The EC200U-CN chip itself supports HW flow control, but the
            Vanix TracX-1b carrier board's Communications Pins header
            does not break out MAIN_RTS/MAIN_CTS (see datasheet Table 3
            -- UART Pins lists only Tx/Rx/GND). This setting has no
            physical pin to connect to on this board and is unused
            while flow control stays at None below.

    config MODEM_UART_CTS_PIN
        int "CTS GPIO (unused on Vanix TracX-1b)"
        default 9
        range -1 48
        help
            See MODEM_UART_RTS_PIN -- not physically available on this
            carrier board.

    config MODEM_UART_BAUD_RATE
        int "UART baud rate"
        default 115200
        help
            Datasheet default is 115200 bps. This carrier board doesn't
            expose MAIN_RTS/MAIN_CTS (HW flow control is not an option
            here), so there's no flow-controlled path to a higher baud --
            230400 was tried and reverted after sustained UART_BREAK/framing
            errors showed up under real-world wiring (breadboard jumpers,
            no shielding), corrupting PPP traffic and stalling OTA
            connects. Only raise this again alongside a genuinely more
            robust physical link (shorter/twisted-pair wiring, solid
            shared ground). Changing this value requires first setting the
            module's own saved UART speed to match via `AT+IPR=<rate>` +
            `AT&W` (one-time, persists across power cycles) BEFORE
            flashing firmware built with the new rate -- see
            modem_set_uart_baud_persist() / the web UI's "Migrate UART
            baud" button.

    choice MODEM_FLOW_CONTROL
        prompt "UART flow control"
        default MODEM_FLOW_CONTROL_NONE
        help
            Always None on the Vanix TracX-1b -- HW flow control needs
            MAIN_RTS/MAIN_CTS wired, which this carrier board's header
            doesn't expose (datasheet Table 3). Software (XON/XOFF) flow
            control isn't a safe substitute here either: PPP's data
            stream is raw binary and will regularly contain byte values
            that coincidentally match XON/XOFF control codes, causing
            spurious flow interruptions mid-transfer.

        config MODEM_FLOW_CONTROL_NONE
            bool "None"
        config MODEM_FLOW_CONTROL_HW
            bool "Hardware (RTS/CTS) -- not wireable on this board"
    endchoice

endmenu
```
